## main/Kconfig.projbuild
```kconfig
menu "EnviLog Configuration"

    config ENVILOG_WIFI_SSID
        string "WiFi SSID"
        default "your-ssid"
        help
            SSID (network name) to connect to.

    config ENVILOG_WIFI_PASSWORD
        string "WiFi Password"
        default "your-password"
        help
            WiFi password (WPA or WPA2) to use.
            Can be left blank if the network is open.

    config ENVILOG_WIFI_CONN_MAX_RETRY
        int "Maximum retry attempts for WiFi connection"
        default 5
        help
            Set the Maximum retry attempts before giving up connection.

    config ENVILOG_WIFI_CONN_TIMEOUT_MS
        int "WiFi Connection Timeout (ms)"
        default 10000
        help
            Timeout in milliseconds for WiFi connection attempts.
    
    config ENVILOG_MQTT_BROKER_URL
        string "MQTT Broker URL"
        default "mqtt://mqtt.eclipseprojects.io"
        help
            URL of MQTT broker to connect to.

    config ENVILOG_MQTT_CLIENT_ID
        string "MQTT Client ID"
        default "envilog_device"
        help
            Client identifier for MQTT connection.
            
    config ENVILOG_MQTT_KEEPALIVE
        int "MQTT Keep-alive timeout (seconds)"
        range 15 600
        default 120
        help
            Keep-alive timeout for MQTT connection.

    config ENVILOG_MQTT_OUTBOX_SIZE
        int "MQTT Outbox Size (KB)"
        default 32
        range 16 256
        help
            Size limit for MQTT outbox in kilobytes.
            Messages are stored here during disconnection.

    config ENVILOG_MQTT_TIMEOUT_MS
        int "MQTT Network Timeout (ms)"
        default 5000
        help
            Timeout for MQTT network operations in milliseconds.

    config ENVILOG_MQTT_RETRY_TIMEOUT_MS
        int "MQTT Retry Timeout (ms)"
        default 3000
        help
            Time between message retry attempts in milliseconds.

    config DHT11_GPIO
        int "DHT11 GPIO number"
        range 0 48
        default 4
        help
            GPIO number (IOxx) to communicate with the DHT11 sensor.

    config DHT11_READ_INTERVAL
        int "DHT11 reading interval (ms)"
        range 2000 300000
        default 10000
        help
            Interval between sensor readings in milliseconds.
            Minimum 2000ms (2 seconds) recommended.

endmenu
```
